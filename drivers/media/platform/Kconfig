## drivers/media/platform/Kconfig
```kconfig
source "drivers/media/platform/msm/Kconfig"
source "drivers/media/platform/broadcom/Kconfig"
```

## drivers/media/platform/broadcom/Kconfig
```kconfig
#
# Broadcom V4L2 Drivers
#

comment "Broadcom V4L2 Drivers"

config BROADCOM_V4L2_DRIVER
	bool "broadcom v4l2 drivers"
	default n
	help
	  Enable broadcom v4l2 drivers supports

source "drivers/media/platform/broadcom/v4l2-driver/Kconfig"
```

## drivers/media/platform/broadcom/v4l2-driver/Kconfig
```kconfig
source "drivers/media/platform/broadcom/v4l2-driver/line_discipline_driver/Kconfig"
source "drivers/media/platform/broadcom/v4l2-driver/bt_protocol_driver/Kconfig"
source "drivers/media/platform/broadcom/v4l2-driver/v4l2_fm_driver/Kconfig"
source "drivers/media/platform/broadcom/v4l2-driver/v4l2_ant_driver/Kconfig"
```

## drivers/media/platform/broadcom/v4l2-driver/bt_protocol_driver/Kconfig
```kconfig
config BROADCOM_V4L2_BT_DRV
	tristate "broadcom v4l2 BT protocol driver"
	depends on BROADCOM_V4L2_DRIVER
	select BROADCOM_V4L2_HCI_LDISC
	default m
	help
	  Enable broadcom v4l2 BT protocol driver supports
```

## drivers/media/platform/broadcom/v4l2-driver/line_discipline_driver/Kconfig
```kconfig
config BROADCOM_V4L2_HCI_LDISC
	tristate "broadcom v4l2 hci ldisc driver"
	depends on BROADCOM_V4L2_DRIVER
	default m
	help
	  Enable broadcom v4l2 hci ldisc driver supports
```

## drivers/media/platform/broadcom/v4l2-driver/v4l2_ant_driver/Kconfig
```kconfig
config BROADCOM_V4L2_ANT_DRV
	tristate "broadcom v4l2 ant driver"
	depends on BROADCOM_V4L2_DRIVER
	select BROADCOM_V4L2_HCI_LDISC
	default m
	help
	  Enable broadcom v4l2 ant driver supports
```

## drivers/net/wireless/bcmdhd/Kconfig
```kconfig
config BCMDHD
	tristate "Broadcom 43xx wireless cards support"
	depends on MMC && CFG80211
	---help---
	  This module adds support for wireless adapters based on
	  Broadcom 43xx chipset.
	  This driver uses the kernel's cfg80211 subsystem.
	  If you choose to build a module, it'll be called dhd. Say M if
	  unsure.

choice
	prompt "Select Broadcom wireless card"
	depends on BCMDHD
	default BCM4339

config BCM4339
	bool "Broadcom 4339 wireless card support"
	depends on BCMDHD
	---help---
	  This module adds support for wireless adapters based on
	  Broadcom 4339 chipset.

config BCM4354
	bool "Broadcom 4354 wireless card support"
	depends on BCMDHD
	---help---
	  This module adds support for wireless adapters based on
	  Broadcom 4354 chipset.

config BCM43455
	bool "Broadcom 43455 wireless cards support"
	depends on BCMDHD
	---help---
	  This module adds support for wireless adapters based on
	  Broadcom 43455 chipset.

endchoice

config BCMDHD_FW_PATH
	depends on BCMDHD
	string "Firmware path"
	default "/system/etc/firmware/fw_bcmdhd.bin"
	---help---
	  Path to the firmware file.

config BCMDHD_NVRAM_PATH
	depends on BCMDHD
	string "NVRAM path"
	default "/system/etc/wifi/bcmdhd.cal"
	---help---
	  Path to the calibration file.

config BCMDHD_HW_OOB
	depends on BCMDHD
	bool "Use H/W OOB to the Host Wakeup"
	default y
	---help---
	  Use H/W OOB to the Host Wakeup

config DHD_USE_SCHED_SCAN
	bool "Use CFG80211 sched scan"
	depends on BCMDHD && CFG80211
	default n
	---help---
	  Use CFG80211 sched scan

config BROADCOM_WIFI_RESERVED_MEM
	bool "BROADCOM Reserved memory for wifi device"
	depends on BCMDHD
	---help---
	  This is a configuration for broadcom WLAN driver.

config BCMDHD_INSMOD_NO_FW_LOAD
	bool "BROADCOM do not load fw during insmod"
	depends on BCMDHD
	---help---
	  This is a configuration for broadcom WLAN driver.
```
